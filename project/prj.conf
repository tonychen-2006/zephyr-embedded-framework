## CMakeLists.txt
```
cmake_minimum_required(VERSION 3.20.0)
find_package(Zephyr REQUIRED HINTS $ENV{ZEPHYR_BASE})

project(project)

target_include_directories(app PRIVATE include)

target_sources(app PRIVATE 
    src/main.c
    src/bus/app_bus.c
    src/modules/comms/comms_uart.c
    src/modules/sensor/sensor_module.c
    src/controller.c
    src/actuator.c
    src/modules/comms/comms_ble.c
)
```

## prj.conf
```kconfig
CONFIG_GPIO=y
CONFIG_LOG=y
CONFIG_LOG_DEFAULT_LEVEL=3
CONFIG_CONSOLE=y
CONFIG_UART_CONSOLE=y
CONFIG_SERIAL=y

CONFIG_BT=y
CONFIG_BT_PERIPHERAL=y
CONFIG_BT_DEVICE_NAME="ZephyrDevice"
CONFIG_BT_SMP=y

CONFIG_BT_BUF_ACL_RX_SIZE=251
CONFIG_BT_BUF_ACL_TX_SIZE=251
```

## src/main.c
```c
#include <zephyr/kernel.h>
#include <zephyr/logging/log.h>
#include <zephyr/drivers/gpio.h>
#include <app/comms_ble.h>

LOG_MODULE_REGISTER(app, LOG_LEVEL_INF);

/**
 * @brief Application entry point
 * 
 * Initializes the BLE communication subsystem and enters idle loop.
 * Other subsystems (controller, actuator, sensor) are started automatically
 * via K_THREAD_DEFINE.
 * 
 * @return Does not return
 */
int main(void) {
    LOG_INF("system boot");

    comms_ble_start(); // Begin BLE controls

    while(1) {
        k_sleep(K_SECONDS(10));
    }
}
```

## src/actuator.c
```c
#include <zephyr/kernel.h>
#include <zephyr/device.h>
#include <zephyr/drivers/gpio.h>
#include <zephyr/logging/log.h>

#include <app/app_bus.h>
#include <app/app_msg.h>

LOG_MODULE_REGISTER(actuator, LOG_LEVEL_INF); // Enable logging

// Get device tree node handles for LEDS led0-led3 from device tree aliases
#define LED0_NODE DT_ALIAS(led0)
#define LED1_NODE DT_ALIAS(led1)
#define LED2_NODE DT_ALIAS(led2)
#define LED3_NODE DT_ALIAS(led3)

#if !DT_NODE_HAS_STATUS(LED0_NODE, okay) || !DT_NODE_HAS_STATUS(LED1_NODE, okay) || \
    !DT_NODE_HAS_STATUS(LED2_NODE, okay) || !DT_NODE_HAS_STATUS(LED3_NODE, okay)
#error "One or more LED aliases are missing/disabled in the devicetree."
#endif

// GPIO descriptors for LEDS led0-led3 (pulled from device tree aliases)
static const struct gpio_dt_spec leds[4] = {
    GPIO_DT_SPEC_GET(LED0_NODE, gpios),
    GPIO_DT_SPEC_GET(LED1_NODE, gpios),
    GPIO_DT_SPEC_GET(LED2_NODE, gpios),
    GPIO_DT_SPEC_GET(LED3_NODE, gpios),
};

static uint8_t led_state[4];

/**
 * @brief Apply LED state change
 * 
 * Sets the specified LED to the requested on/off state and updates the internal state tracking.
 * 
 * @param id LED identifier (0-3)
 * @param on Desired state: 1 for on, 0 for off
 * @return 0 on success, -EINVAL if id invalid, -ENODEV if device not ready
 */
static int led_apply(uint8_t id, uint8_t on) {

    // Validate LED id is in range [0, 3]
    if (id >= 4) {
        return -EINVAL;
    }

    // Validate GPIO device is initialized and ready
    if (!device_is_ready(leds[id].port)) {
        return -ENODEV;
    }

    // Set GPIO pin to the requested level (1=on, 0=off)
    int rc = gpio_pin_set_dt(&leds[id], on ? 1 : 0);

    if (rc == 0) {
        led_state[id] = on ? 1 : 0;
    }

    return rc;
}

/**
 * @brief Toggle the state of the specified LED
 * 
 * Public interface for toggling LEDs. Can be called directly from other modules
 * to control LEDs without using the message bus.
 * 
 * @param led_id LED identifier (0-3)
 */
void actuator_led_toggle(uint8_t led_id)
{
    if (led_id < 4) {
        (void)led_apply(led_id, (uint8_t)!led_state[led_id]);
        LOG_INF("LED%u toggle -> %u", led_id, led_state[led_id]);
    }
}

/**
 * @brief Handle incoming command messages
 * 
 * Processes command messages from the message bus and executes the appropriate action.
 * Supports LED control, mode changes, and statistics reset.
 * 
 * @param cmd Pointer to the command payload
 */
static void handle_cmd(const struct app_command_payload *cmd) {

    uint8_t id;
    uint8_t on;

    switch (cmd->command_id) {

        case APP_CMD_LED_TOGGLE:
            // Toggle the specified LED: extract ID from lower byte of value
            id = (uint8_t)cmd->value;

            if (id < 4) {
                (void)led_apply(id, (uint8_t)!led_state[id]);
                LOG_INF("LED%u toggle -> %u", id, led_state[id]);
            }
            break;

        case APP_CMD_LED_SET:
            // Set LED state explicitly: upper byte = ID, lower byte = on/off state
            id = (uint8_t)((cmd->value >> 8) & 0xFF);
            on = (uint8_t)(cmd->value & 0xFF);
            
            if (id < 4) {
                (void)led_apply(id, on ? 1 : 0);
                LOG_INF("LED%u toggle -> %u", id, led_state[id]);
            }
            break;

        case APP_CMD_SET_MODE:
            // Change mode indicator: turn off all LEDs, then turn on the one matching the mode
            for (uint8_t i = 0; i < 4; i++) {
                (void)led_apply(i, 0);
            }

            switch ((enum app_mode)cmd->value) {

                case APP_MODE_IDLE:
                    (void)led_apply(0, 1);
                    break;

                case APP_MODE_ACTIVE:
                    (void)led_apply(1, 1);
                    break;
                
                case APP_MODE_DIAG:
                    (void)led_apply(2, 1);
                    break;

                default:
                    (void)led_apply(3, 1);
                    break;
            }

            LOG_INF("mode indicator -> %u", (unsigned)cmd->value);
            break;

        case APP_CMD_RESET_STATS:
            // Flash LED 3 briefly as reset acknowledgment (80 ms pulse)
            (void)led_apply(3, 1);
            k_sleep(K_MSEC(80));
            (void)led_apply(3, 0);
            LOG_INF("reset ack");
            break;

        default:
            break;
    }
}

/**
 * @brief Actuator thread main function
 * 
 * Initializes LED GPIO pins and enters main loop to process command messages
 * from the message bus. Controls LEDs based on received commands.
 * 
 * Thread priority: 8 (lower priority than controller)
 */
static void actuator_thread(void) {

    // Initialize all 4 LED GPIO pins as outputs, initially off
    for (int i = 0; i < 4; i++) {
        if(!device_is_ready(leds[i].port)) {
            LOG_ERR("LED%d device not ready", i);
            continue;
        }

        int rc = gpio_pin_configure_dt(&leds[i], GPIO_OUTPUT_INACTIVE);

        if (rc != 0) {
            LOG_ERR("LED%d configure failed (%d)", i, rc);
        } else {
            led_state[i] = 0;
        }
    }

    LOG_INF("actuator start");

    // Main event loop: wait for and process command messages from the bus
    while (1) {
        struct app_msg msg;

        LOG_DBG("actuator waiting for message");
        int rc = app_bus_get(&msg, K_FOREVER);

        if (rc != 0) {
            LOG_ERR("app_bus_get failed: %d", rc);
            continue;
        }

        LOG_DBG("actuator got msg type=%d", msg.type);
        // Only process command messages; ignore other message types
        if (msg.type == APP_MSG_COMMAND) {
            handle_cmd(&msg.data.command);
        }
    }
}

// Create and start the actuator thread with 1024-byte stack, priority 8 (higher priority than sensors)
K_THREAD_DEFINE(actuator_tid, 1024, actuator_thread, NULL, NULL, NULL, 8, 0, 0);
```

## src/controller.c
```c
#include <zephyr/kernel.h>
#include <zephyr/logging/log.h>
#include <app/app_bus.h>
#include <app/app_msg.h>
#include <app/comms_ble.h>
#include <app/actuator.h>

LOG_MODULE_REGISTER(controller, LOG_LEVEL_INF); // Enable logging

static enum app_mode g_mode = APP_MODE_IDLE;
static uint32_t g_button_press_count[16];

/**
 * @brief Publish a command to the message bus
 * 
 * Creates and publishes a command message to the application bus.
 * Logs errors if the bus is full.
 * 
 * @param cmd_id Command identifier
 * @param value Command value parameter
 */
static void publish_cmd(uint8_t cmd_id, uint32_t value) {

    LOG_INF("publish_cmd: id=%u val=%u", cmd_id, value);
    
    struct app_msg out = {0};

    out.type = APP_MSG_COMMAND;
    out.source = APP_SRC_CONTROLLER;
    out.timestamp_ms = (uint32_t)k_uptime_get();
    out.data.command.command_id = cmd_id;
    out.data.command.value = value;

    int rc = app_bus_publish(&out);

    if (rc != 0) {
        LOG_ERR("cmd publish failed! drops=%u", app_bus_drop_count());
    } else {
        LOG_INF("publish_cmd succeeded");
    }
}

/**
 * @brief Set the system operating mode
 * 
 * Changes the current system mode and logs the transition.
 * 
 * @param new_mode Desired operating mode
 */
static void set_mode(enum app_mode new_mode) {

    if (new_mode >= APP_MODE_MAX) {
        return;
    }

    if (new_mode != g_mode) {
        g_mode = new_mode;
        LOG_INF("mode -> %d", g_mode);
        publish_cmd(APP_CMD_SET_MODE, (uint32_t)g_mode);
    }
}

/**
 * @brief Handle button press/release events
 * 
 * Processes button events from the sensor module. Sends BLE notifications for all events
 * and triggers LED toggles or other actions for button presses. Maintains press counters
 * for each button.
 * 
 * @param b Pointer to the button event payload
 */
static void handle_button_event(const struct app_button_payload *b) {

    LOG_INF("handle_button_event: id=%u pressed=%u", b->button_id, b->pressed);
    
    // Send BLE notification for both press and release
    comms_ble_notify_button(b->button_id, b->pressed, (uint32_t)k_uptime_get());
    
    LOG_INF("BLE notify returned");

    // Ignore button release events; only process presses
    if (!b ->pressed) {
        return; // acts only when pressed not release
    }

    // Track button press count (if button ID is in range)
    if (b->pressed < 16) {
        g_button_press_count[b->button_id]++;
    }

    switch(b->button_id) {

        case 0:
            // Button 0: toggle LED 0
            LOG_INF("button 0: toggling LED");
            actuator_led_toggle(0);
            break;

        case 1:
            // Button 1: toggle LED 1
            LOG_INF("button 1: toggling LED");
            actuator_led_toggle(1);
            break;
        
        case 2:
            // Button 2: toggle LED 2 and cycle to next mode (IDLE → ACTIVE → DIAG → IDLE...)
            actuator_led_toggle(2);
            set_mode((enum app_mode)((g_mode + 1) % APP_MODE_MAX));
            break;
        
        case 3:
            // Button 3: toggle LED 3, reset all button counters, and publish reset command
            actuator_led_toggle(3);
            for (int i = 0; i < 16; i++) {
                g_button_press_count[i] = 0;
            }

            publish_cmd(APP_CMD_RESET_STATS, 0);
            LOG_INF("stats reset");
            break;
        
        default:
            // Any other button: just log the press event with its counter
            LOG_INF("btn %u pressed (count=%u)", 
                    b->button_id,
                    (b->button_id < 16) ? g_button_press_count[b->button_id] : 0);
            break;
    }
}

/**
 * @brief Controller thread main function
 * 
 * Main event loop that processes button events and commands from the message bus.
 * Coordinates LED control, mode changes, and BLE notifications.
 * 
 * Thread priority: 7 (higher than actuator, lower than sensor)
 */
static void controller_thread(void) {

    LOG_INF("controller start");

    // Main event loop: wait for and dispatch button events and commands
    while (1) {
        
        struct app_msg msg;

        LOG_INF("controller waiting for message");
        int rc = app_bus_get(&msg, K_FOREVER);

        if (rc != 0) {
            LOG_ERR("app_bus_get failed: %d", rc);
            continue;
        }

        LOG_INF("controller got msg type=%d", msg.type);

        switch (msg.type) {

            case APP_MSG_BUTTON_EVENT:
                // Handle button press/release and send BLE notifications
                handle_button_event(&msg.data.button);
                break;

            case APP_MSG_COMMAND:
                // Handle SET_MODE commands from BLE (comms), pass others to actuator
                if (msg.source == APP_SRC_COMMS && 
                    msg.data.command.command_id == APP_CMD_SET_MODE) {
                        set_mode((enum app_mode)msg.data.command.value);
                } else {
                    // Re-publish commands that are not handled so actuator can process them
                    app_bus_publish(&msg);
                }
                break;

            case APP_MSG_STATUS:
                // Status messages not yet implemented
                break;

            default:
                break;
        }
    }
}

// Create and start the controller thread with 1024-byte stack, priority 7 (between sensor and actuator)
K_THREAD_DEFINE(controller_tid, 1024, controller_thread, NULL, NULL, NULL, 7, 0, 0);
```
